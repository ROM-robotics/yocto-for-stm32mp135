## layers/meta-rom-custom/conf/layer.conf
```bitbake
# ROM Custom Layer
BBPATH .= ":${LAYERDIR}"
BBFILES += "${LAYERDIR}/recipes-*/*/*.bb ${LAYERDIR}/recipes-*/*/*.bbappend"

BBFILE_COLLECTIONS += "rom-custom"
BBFILE_PATTERN_rom-custom = "^${LAYERDIR}/"
BBFILE_PRIORITY_rom-custom = "10"

LAYERSERIES_COMPAT_rom-custom = "scarthgap"
LAYERDEPENDS_rom-custom = "core"
```

## layers/meta-rom-splash/conf/layer.conf
```bitbake
# Layer configuration for meta-rom-splash
# Custom splash screen layer for ROM project

BBPATH .= ":${LAYERDIR}"

BBFILES += "${LAYERDIR}/recipes-*/*/*.bb \
            ${LAYERDIR}/recipes-*/*/*.bbappend"

BBFILE_COLLECTIONS += "rom-splash"
BBFILE_PATTERN_rom-splash = "^${LAYERDIR}/"
BBFILE_PRIORITY_rom-splash = "10"

LAYERSERIES_COMPAT_rom-splash = "scarthgap"
LAYERDEPENDS_rom-splash = "core"
```
